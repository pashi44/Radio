## drivers/Kconfig
```kconfig
menu "Radio  Custom   device drivers"

    # rsource "uartone/Kconfig"
    rsource "customitwoc/Kconfig"

endmenu
```

## drivers/customitwoc/Kconfig
```kconfig
config RADIO_CUSTOM_ITWOC
    bool "Custom Itwoc driver"
    default n
    depends on  I2C &&   GPIO
    help
      Enable the Custom Itwoc driver.
```

## drivers/itwoc/Kconfig
```kconfig
config   BINZ_ITWOC
    bool "Enable ItwoC Radio manual BINZ Driver"
    depends on I2C
    depends on GPIO
    default n
```
