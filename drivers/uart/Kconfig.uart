## drivers/uart/Kconfig.uart
```kconfig
menu "Radio UART Driver"

config RADIO_UART_INSTANCE
    bool "Enable Radio UART Driver"
    default n
    help
      Enable the Radio UART driver instance for the Radio project.

endmenu
```

## drivers/uartone/Kconfig.uartone
```kconfig
config  RADIO_UART_INSTANCE
  bool "Enable Radio UART  manual  Driver  instance"
  default n
  help
      Enable this option to use the manual UART driver instance for Radio communication.
      
```

## interrupts/Kconfig
```kconfig
menu "Radio  interrupts"

config RADIO_INTERRUPTS
    bool "Enable Radio Threads"
    default y
    help
      Enable the  Interrupts module used by the Radio app.

endmenu
```

## threads/Kconfig
```kconfig
menu "Radio Threads Options"

config RADIO_THREADS
    bool "Enable Radio Threads"
    default y
    help
      Enable the thread module used by the Radio app.

endmenu
```
